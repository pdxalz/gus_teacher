## CMakeLists.txt
```
# SPDX-License-Identifier: Apache-2.0

cmake_minimum_required(VERSION 3.13.1)

set(SHIELD adafruit_2_8_tft_touch_v2)

find_package(Zephyr REQUIRED HINTS $ENV{ZEPHYR_BASE})
project(lvgl)

FILE(GLOB app_sources src/*.c)
target_sources(app PRIVATE ${app_sources})
target_include_directories(app PRIVATE include)
```

## prj.conf
```kconfig
CONFIG_HEAP_MEM_POOL_SIZE=16384
CONFIG_MAIN_STACK_SIZE=4096

# General configuration
CONFIG_SYSTEM_WORKQUEUE_STACK_SIZE=4096
CONFIG_FLASH=y
CONFIG_FLASH_MAP=y
CONFIG_FCB=y
CONFIG_SETTINGS=y
CONFIG_HWINFO=y
CONFIG_ASSERT=y
CONFIG_ASSERT_LEVEL=2
CONFIG_LOG=y
CONFIG_LOG_PRINTK=y

CONFIG_DK_LIBRARY=y



# Enable the LBS service
CONFIG_BT_LBS=y

# Bluetooth configuration
CONFIG_BT=y
CONFIG_BT_COMPANY_ID=0x0059
CONFIG_BT_DEVICE_NAME="Gus_Teacher"
CONFIG_BT_L2CAP_RX_MTU=69
CONFIG_BT_L2CAP_TX_MTU=69
CONFIG_BT_L2CAP_TX_BUF_COUNT=32
CONFIG_BT_LL_SW_SPLIT=y
CONFIG_BT_OBSERVER=y
CONFIG_BT_PERIPHERAL=y
CONFIG_BT_SETTINGS=y
CONFIG_BT_TINYCRYPT_ECC=y
CONFIG_BT_MESH_DK_PROV=y
CONFIG_BT_DEVICE_NAME="Gus_Teacher"
#fixes error: No matching TX context for ack error
CONFIG_BT_MESH_TX_SEG_MSG_COUNT=3

# Disable unused Bluetooth features
CONFIG_BT_CTLR_DUP_FILTER_LEN=0
CONFIG_BT_CTLR_LE_ENC=n
CONFIG_BT_DATA_LEN_UPDATE=n
CONFIG_BT_PHY_UPDATE=n
CONFIG_BT_CTLR_CHAN_SEL_2=n
CONFIG_BT_CTLR_MIN_USED_CHAN=n
CONFIG_BT_CTLR_PRIVACY=n

# Bluetooth mesh configuration
CONFIG_BT_MESH=y
CONFIG_BT_MESH_RELAY=y
CONFIG_BT_MESH_FRIEND=y
CONFIG_BT_MESH_ADV_BUF_COUNT=64
CONFIG_BT_MESH_TX_SEG_MAX=32
CONFIG_BT_MESH_PB_GATT=y
CONFIG_BT_MESH_GATT_PROXY=y

CONFIG_BT_MESH_CRPL=30

# Bluetooth mesh models
CONFIG_BT_MESH_ONOFF_CLI=y
CONFIG_BT_MESH_LVL_CLI=y

# GUI Configuration
CONFIG_DISPLAY=y
CONFIG_DISPLAY_LOG_LEVEL_OFF=y
CONFIG_LVGL_LOG_LEVEL_OFF=y

CONFIG_LVGL=y
CONFIG_LVGL_ANTIALIAS=y
CONFIG_LVGL_USE_LABEL=y
CONFIG_LVGL_USE_CONT=y
CONFIG_LVGL_USE_BTN=y
CONFIG_LVGL_USE_CHECKBOX=y
CONFIG_LVGL_USE_IMG=y
CONFIG_LVGL_USE_THEME_MATERIAL=y
CONFIG_LVGL_USE_ANIMATION=y
CONFIG_LVGL_USE_SHADOW=y

CONFIG_LVGL_USE_PAGE=y
CONFIG_LVGL_USE_BTNMATRIX=y
CONFIG_LVGL_USE_TABVIEW=y
CONFIG_LVGL_USE_DROPDOWN=y
CONFIG_LVGL_USE_ROLLER=y
CONFIG_LVGL_USE_KEYBOARD=y
CONFIG_LVGL_USE_BAR=y
CONFIG_LVGL_USE_SLIDER=y
CONFIG_LVGL_USE_LIST=y
CONFIG_LVGL_USE_TEXTAREA=y
CONFIG_LVGL_USE_SPINBOX=y

CONFIG_LVGL_TXT_ENC_UTF8=y
CONFIG_LVGL_THEME_DEFAULT_FONT_NORMAL_MONTSERRAT_14=y
CONFIG_LVGL_THEME_MATERIAL_DARK=y
CONFIG_LVGL_THEME_DEFAULT_COLOR_PRIMARY_NAVY=y
CONFIG_LVGL_FONT_MONTSERRAT_14=y
CONFIG_NEWLIB_LIBC=y

CONFIG_LVGL_POINTER_KSCAN_MSGQ_COUNT=30
```

## src/main.c
```c
/*
 * Copyright (c) 2018 Jan Van Winkel <jan.van_winkel@dxplore.eu>
 *
 * SPDX-License-Identifier: Apache-2.0
 */

#include <device.h>
#include <drivers/display.h>
#include <lvgl.h>
#include <stdio.h>
#include <string.h>
#include <zephyr.h>
#include <bluetooth/bluetooth.h>
#include <bluetooth/mesh/models.h>
#include <bluetooth/mesh/dk_prov.h>
#include <dk_buttons_and_leds.h>
#include "model_handler.h"
#include "gui.h"
#include "simulate.h"

//#define LOG_LEVEL CONFIG_LOG_DEFAULT_LEVEL
//#include <logging/log.h>
//LOG_MODULE_REGISTER(app);

static void bt_ready(int err)
{
	if (err)
	{
		printk("Bluetooth init failed (err %d)\n", err);
		return;
	}

	printk("Bluetooth initialized\n");

	dk_leds_init();
	dk_buttons_init(NULL);

	err = bt_mesh_init(bt_mesh_dk_prov_init(), model_handler_init());
	if (err)
	{
		printk("Initializing mesh failed (err %d)\n", err);
		return;
	}

	if (IS_ENABLED(CONFIG_SETTINGS))
	{
		settings_load();
	}

	/* This will be a no-op if settings_load() loaded provisioning info */
	bt_mesh_prov_enable(BT_MESH_PROV_ADV | BT_MESH_PROV_GATT);

	printk("Mesh initialized\n");
}

void on_gui_event(gui_event_t *event)
{
	switch (event->evt_type)
	{
	case GUI_EVT_SCAN:
		model_scan_for_badges();
		gui_update_namelist();
		update_checkboxes();
		break;
	case GUI_EVT_IDENTIFY:
		model_handler_set_state(event->addr, BT_MESH_GUS_IDENTIFY);
		break;
	case GUI_EVT_RECORD:
		model_report_request(event->addr);
		break;
	}
}

void main(void)
{
	int err;

	gui_config_t gui_config = {.event_callback = on_gui_event};
	gui_init(&gui_config);

	printk("Initializing...\n");

	err = bt_enable(bt_ready);
	if (err)
	{
		printk("Bluetooth init failed (err %d)\n", err);
	}

	while (1)
	{
		k_sleep(K_MSEC(1000));
	}
}
```

## include/contacts.h
```c
#ifndef CONTACTS_H_
#define CONTACTS_H_

//void init_contacts(void);
uint16_t get_total_contacts(void);
uint16_t get_start_time(int index);
uint16_t get_end_time(int index);
uint16_t get_distance_squared(int index);
uint8_t get_contact_badgeA(int index);
uint8_t get_contact_badgeB(int index);
uint16_t final_time(void);
void simulate_contacts( uint8_t rows, uint8_t space);
void add_contact(uint16_t badgeA, uint16_t badgeB, uint32_t start_time, uint32_t end_time, double distance);
void reset_proximity_contacts(void);
void add_proximity_contact(uint16_t badgeA, uint16_t badgeB, int8_t rssi);
#endif /* CONTACTS_H_ */
```

## include/gui.h
```c
#ifndef __GUI_H
#define __GUI_H

#include <zephyr.h>

typedef enum {GUI_EVT_SCAN, GUI_EVT_IDENTIFY} gui_event_type_t;

typedef struct
{
	gui_event_type_t evt_type;
	uint16_t addr;
} gui_event_t;

typedef enum  {GUI_MSG_UPDATE_LIST, GUI_MSG_PROGRESS} gui_msg_type_t;

typedef struct
{
	gui_msg_type_t type;
	void *p_data;
	struct 
	{
		uint16_t param;
		uint8_t progress;
	} params;
} gui_message_t;


typedef void (*gui_callback_t)(gui_event_t *event);

typedef struct
{
	gui_callback_t event_callback;
} gui_config_t;

void gui_init(gui_config_t * config);

void gui_update(void);
void gui_update_namelist(void);
void update_checkboxes(void);
void gui_update_progress(uint8_t progress, uint16_t time);

#endif
```

## include/gus_cli.h
```c
/*
 * Copyright (c) 2020 Nordic Semiconductor ASA
 *
 * SPDX-License-Identifier: LicenseRef-Nordic-5-Clause
 */

/**
 * @file
 * @defgroup bt_mesh_gus_cli
 * @{
 * @brief API for the Bluetooth Mesh Gus Client model.
 */

#ifndef BT_MESH_GUS_CLI_H__
#define BT_MESH_GUS_CLI_H__

#include <bluetooth/mesh.h>
#include <bluetooth/mesh/model_types.h>

#ifdef __cplusplus
extern "C" {
#endif

#define CONFIG_BT_MESH_GUS_NAME_LENGTH 16

/* .. include_startingpoint_gus_cli_rst_1 */
/** Company ID of the Bluetooth Mesh Gus Client model. */
#define BT_MESH_GUS_CLI_VENDOR_COMPANY_ID    0xFFFF  // not a real company

/** Model ID of the Bluetooth Mesh Gus Client model. */
#define BT_MESH_GUS_CLI_VENDOR_MODEL_ID      0x0042 // answer to life, universe & everything

/** Sign in opcode. */
#define BT_MESH_GUS_CLI_OP_SIGN_IN BT_MESH_MODEL_OP_3(0x04, \
				       BT_MESH_GUS_CLI_VENDOR_COMPANY_ID)

/** Sign in reply opcode. */
#define BT_MESH_GUS_CLI_OP_SIGN_IN_REPLY BT_MESH_MODEL_OP_3(0x05, \
				       BT_MESH_GUS_CLI_VENDOR_COMPANY_ID)

/** Set State opcode. */
#define BT_MESH_GUS_CLI_OP_SET_STATE BT_MESH_MODEL_OP_3(0x06, \
				       BT_MESH_GUS_CLI_VENDOR_COMPANY_ID)

/** Set name opcode. */
#define BT_MESH_GUS_CLI_OP_SET_NAME BT_MESH_MODEL_OP_3(0x07, \
				       BT_MESH_GUS_CLI_VENDOR_COMPANY_ID)

/**  Report opcode. */
#define BT_MESH_GUS_CLI_OP_REPORT BT_MESH_MODEL_OP_3(0x08, \
				       BT_MESH_GUS_CLI_VENDOR_COMPANY_ID)

/** Report reply opcode. */
#define BT_MESH_GUS_CLI_OP_REPORT_REPLY BT_MESH_MODEL_OP_3(0x09, \
				       BT_MESH_GUS_CLI_VENDOR_COMPANY_ID)

/** Check proximity opcode. */
#define BT_MESH_GUS_CLI_OP_CHECK_PROXIMITY BT_MESH_MODEL_OP_3(0x0A, \
				       BT_MESH_GUS_CLI_VENDOR_COMPANY_ID)

#define NUM_PROXIMITY_REPORTS 8
struct gus_report_data {
    uint8_t addr;
    int8_t rssi;
    }; 


#define BT_MESH_GUS_CLI_MSG_MINLEN_MESSAGE 1
#define BT_MESH_GUS_CLI_MSG_MAXLEN_MESSAGE (\
				     CONFIG_BT_MESH_GUS_NAME_LENGTH \
				     + 1) /* + \0 */
#define BT_MESH_GUS_CLI_MSG_LEN_SIGN_IN_REPLY (CONFIG_BT_MESH_GUS_NAME_LENGTH + 1)
#define BT_MESH_GUS_CLI_MSG_LEN_SET_STATE 1
#define BT_MESH_GUS_CLI_MSG_LEN_REPORT_REPLY (NUM_PROXIMITY_REPORTS*sizeof(struct gus_report_data)+1)
#define BT_MESH_GUS_CLI_MSG_LEN_REQUEST 0


/** Bluetooth Mesh Gus Client state values. */
enum bt_mesh_gus_cli_state {
	BT_MESH_GUS_CLI_IDENTIFY,
	BT_MESH_GUS_CLI_HEALTHY,
	BT_MESH_GUS_CLI_INFECTED,
	BT_MESH_GUS_CLI_MASKED,
	BT_MESH_GUS_CLI_MASKED_INFECTED,
	BT_MESH_GUS_CLI_VACCINATED,
	BT_MESH_GUS_CLI_VACCINATED_INFECTED,
	BT_MESH_GUS_CLI_VACCINATED_MASKED,
	BT_MESH_GUS_CLI_VACCINATED_MASKED_INFECTED,	
        BT_MESH_GUS_CLI_OFF,
};

/* Forward declaration of the Bluetooth Mesh Gus Client model context. */
struct bt_mesh_gus_cli;

/* .. include_startingpoint_gus_cli_rst_2 */
/** @def BT_MESH_MODEL_GUS_CLI
 *
 * @brief Bluetooth Mesh Gus Client model composition data entry.
 *
 * @param[in] _gus Pointer to a @ref bt_mesh_gus_cli instance.
 */
#define BT_MESH_MODEL_GUS_CLI(_gus)                               \
		BT_MESH_MODEL_VND_CB(BT_MESH_GUS_CLI_VENDOR_COMPANY_ID,   \
			BT_MESH_GUS_CLI_VENDOR_MODEL_ID,                      \
			_bt_mesh_gus_cli_op, &(_gus)->pub,                    \
			BT_MESH_MODEL_USER_DATA(struct bt_mesh_gus_cli,       \
						_gus),                        \
			&_bt_mesh_gus_cli_cb)
/* .. include_endpoint_gus_cli_rst_2 */

/** Bluetooth Mesh Gus Client model handlers. */
struct bt_mesh_gus_cli_handlers {
	/** @brief Called after the node has been provisioned, or after all
	 * mesh data has been loaded from persistent storage.
	 *
	 * @param[in] cli Gus Client instance that has been started.
	 */
	void (*const start)(struct bt_mesh_gus_cli *gus);

	/** @brief Handler for a sign in message.
	 *
	 * @param[in] cli Gus client instance that received the text message.
	 * @param[in] ctx Context of the incoming message.
	 * @param[in] addr address of sender.
	 */
	void (*const sign_in)(struct bt_mesh_gus_cli *gus,
			       struct bt_mesh_msg_ctx *ctx,
                               uint16_t addr);

	/** @brief Handler for a sign in reply.
	 *
	 * @param[in] cli Gus client instance that received the reply.
	 * @param[in] ctx Context of the incoming message.
	 * @param[in] msg Pointer to a name terminated with
	 * a null character, '\0'.
	 */
	void (*const sign_in_reply)(struct bt_mesh_gus_cli *gus,
				    struct bt_mesh_msg_ctx *ctx,
				      const uint8_t *msg);

	/** @brief Handler for a set state message.
	 *
	 * @param[in] cli gus client instance that received the text message.
	 * @param[in] ctx Context of the incoming message.
	 * @param[in] state of a Gus Client
	 * the message.
	 */
	void (*const set_state)(struct bt_mesh_gus_cli *gus,
			       struct bt_mesh_msg_ctx *ctx,
			       enum bt_mesh_gus_cli_state state);

	/** @brief Handler for a set name message.
	 *
	 * @param[in] cli Gus client that received the text message.
	 * @param[in] ctx Context of the incoming message.
	 * @param[in] msg Pointer to a received name terminated with
	 * a null character, '\0'.
	 */
	void (*const set_name)(struct bt_mesh_gus_cli *gus,
				      struct bt_mesh_msg_ctx *ctx,
				      const uint8_t *msg);

	/** @brief Handler for a report request.
	 *
	 * @param[in] cli Gus client instance that received the text message.
	 * @param[in] ctx Context of the incoming message.
	 */
	void (*const report_request)(struct bt_mesh_gus_cli *gus,
			       struct bt_mesh_msg_ctx *ctx);

	/** @brief Handler for a reply on a report request.
	 *
	 * @param[in] cli Gus client instance that received the reply.
	 * @param[in] ctx Context of the incoming message.
	 * @param[in] msg Pointer to a proximity report structure
	 * a null character, '\0'.	 */
	void (*const report_reply)(struct bt_mesh_gus_cli *gus,
				    struct bt_mesh_msg_ctx *ctx,
				      const uint8_t *msg);

	/** @brief Handler for a check proximity message.
	 *
	 * @param[in] cli Gus client instance that received the text message.
	 * @param[in] ctx Context of the incoming message.
	 * @param[in] addr address of sender.
	 */
	void (*const check_proximity)(struct bt_mesh_gus_cli *gus,
			       struct bt_mesh_msg_ctx *ctx,
                               uint16_t addr);


};


/**
 * Bluetooth Mesh Gus Client model context.
 */
struct bt_mesh_gus_cli {
	/** Access model pointer. */
	struct bt_mesh_model *model;
	/** Publish parameters. */
	struct bt_mesh_model_pub pub;
	/** Publication message. */
	struct net_buf_simple pub_msg;
	/** badge name. */
	uint8_t buf[BT_MESH_MODEL_BUF_LEN(BT_MESH_GUS_CLI_OP_SET_NAME,
					  BT_MESH_GUS_CLI_MSG_MAXLEN_MESSAGE)];
        uint8_t name[CONFIG_BT_MESH_GUS_NAME_LENGTH+1];
	/** Handler function structure. */
	const struct bt_mesh_gus_cli_handlers *handlers;
	/** Current Presence value. */
	enum bt_mesh_gus_cli_state state;
};






/** @brief Publish the sign in request to the mesh network.
 *
 * @param[in] gus     Gus Client model instance to sign into.
 *
 * @retval 0 Successfully set the preceive and sent the message.
 * @retval -EADDRNOTAVAIL Publishing is not configured.
 * @retval -EAGAIN The device has not been provisioned.
 */
int bt_mesh_gus_cli_sign_in(struct bt_mesh_gus_cli *gus);

/** @brief Send a reply for the sign in request to the mesh network.
 *
 * @param[in] gus     Gus Client model instance to sign into.
 * @param[in] name Pointer to a name. Must be terminated with
 * a null character, '\0'.
 *
 * @retval 0 Successfully set the preceive and sent the message.
 * @retval -EADDRNOTAVAIL Publishing is not configured.
 * @retval -EAGAIN The device has not been provisioned.
 */
int bt_mesh_gus_cli_sign_in_reply(struct bt_mesh_gus_cli *gus, 
                                    struct bt_mesh_msg_ctx *ctx, 
                                    const uint8_t * name);
/** @brief Set the client state.
 *
 * @param[in] gus     Gus Client model instance to set presence on.
 * @param[in] addr    Address of the gus client to set the state of.
 * @param[in] state   New client state.
 *
 * @retval 0 Successfully set the preceive and sent the message.
 * @retval -EADDRNOTAVAIL Publishing is not configured.
 * @retval -EAGAIN The device has not been provisioned.
 */
int bt_mesh_gus_cli_state_set(struct bt_mesh_gus_cli *gus,
				  uint16_t addr,
				  enum bt_mesh_gus_cli_state state);

/** @brief Set the client name.
 *
 * @param[in] cli Gus Client model instance.
 * @param[in] addr    Address of the gus client to set the state of.
 * @param[in] name Pointer to a name. Must be terminated with
 * a null character, '\0'.
 *
 * @retval 0 Successfully sent the message.
 * @retval -EADDRNOTAVAIL Publishing is not configured.
 * @retval -EAGAIN The device has not been provisioned.
 */
int bt_mesh_gus_cli_name_set(struct bt_mesh_gus_cli *gus,
				  uint16_t addr,
				  const uint8_t *name);

/** @brief Request a proximity report.
 *
 * @param[in] gus     Gus Client model instance to sign into.
 * @param[in] addr    Address of the gus client.
 *
 * @retval 0 Successfully set the preceive and sent the message.
 * @retval -EADDRNOTAVAIL Publishing is not configured.
 * @retval -EAGAIN The device has not been provisioned.
 */
int bt_mesh_gus_cli_report_request(struct bt_mesh_gus_cli *gus,
				  uint16_t addr);

/** @brief Proximity report reply.
 *
 * @param[in] gus     Gus Client model instance to sign into.
 * @param[in] report Pointer array of bytes containing report
 *
 * @retval 0 Successfully set the preceive and sent the message.
 * @retval -EADDRNOTAVAIL Publishing is not configured.
 * @retval -EAGAIN The device has not been provisioned.
 */
int bt_mesh_gus_cli_report_reply(struct bt_mesh_gus_cli *gus,
				  struct bt_mesh_msg_ctx *ctx, 
				  const uint8_t *report);

/** @brief Check Proximity.
 *
 * @param[in] gus     Gus Client model instance to sign into.
 *
 * @retval 0 Successfully set the preceive and sent the message.
 * @retval -EADDRNOTAVAIL Publishing is not configured.
 * @retval -EAGAIN The device has not been provisioned.
 */
int bt_mesh_gus_cli_check_proximity(struct bt_mesh_gus_cli *gus);

/** @cond INTERNAL_HIDDEN */
extern const struct bt_mesh_model_op _bt_mesh_gus_cli_op[];
extern const struct bt_mesh_model_cb _bt_mesh_gus_cli_cb;
/** @endcond */

#ifdef __cplusplus
}
#endif

#endif /* BT_MESH_GUS_CLI_H__ */

/** @} */
```

## include/gus_config.h
```c
#ifndef __GUS_CONFIG_H
#define __GUS_CONFIG_H

//#include <zephyr.h>


#define MAX_GUS_NODES 10
#define MAX_NAME_LENGTH 12
#endif  //__GUS_CONFIG_H
```

## include/gus_data.h
```c
#ifndef __GUS_DATA_H
#define __GUS_DATA_H

//#include <zephyr.h>

#define NAMESIZE 14
#define MAX_BADGES 32


void gd_init(void);

bool is_patient_zero(int index);
void set_patient_zero(int index, bool patient_zero);
bool has_mask(int index);
void set_masked(int index, bool masked);
bool has_vaccine(int index);
void set_vaccine(int index, bool vaccine);
uint16_t get_address(int index);
void gd_add_node(const char * name, uint16_t addr, bool patient_zero, bool mask, bool vaccine);
uint16_t gd_get_node_count(void);
void gd_get_namelist(char * buf, int length);
bool get_infected(int index);
void set_infected(int index, bool infected);
uint32_t get_exposure(int index);
void set_exposure(int index, uint32_t exposure);
void gd_add_exposure(int index, uint32_t exposure, bool update);
char * get_name(int index);
void set_name(int index, const char * name);
void reset_exposures(bool update);
bool everyone_infected(void);

#endif  //__GUS_DATA_H
```

## include/model_handler.h
```c
/*
 * Copyright (c) 2019 Nordic Semiconductor ASA
 *
 * SPDX-License-Identifier: LicenseRef-Nordic-5-Clause
 */

/**
 * @file
 * @brief Model handler
 */

#ifndef MODEL_HANDLER_H__
#define MODEL_HANDLER_H__

#include <bluetooth/mesh.h>
#include "gus_cli.h"
#ifdef __cplusplus
extern "C" {
#endif


const struct bt_mesh_comp *model_handler_init(void);
void model_handler_provision(void);
void model_handler_set_state(uint16_t index, enum bt_mesh_gus_cli_state state);
void model_scan_for_badges(void);
void model_set_name(uint16_t addr, const uint8_t *name);


#ifdef __cplusplus
}
#endif

#endif /* MODEL_HANDLER_H__ */
```

## include/sim_settings.h
```c
#ifndef __SIM_SETTINGS_H
#define __SIM_SETTINGS_H

//#include <zephyr.h>

bool get_sim_proximity(void);
void set_sim_proximity(bool prox);
uint8_t get_sim_rows(void);
void set_sim_rows(uint8_t rows);
uint8_t get_sim_spacing(void);
void set_sim_spacing(uint8_t spacing);
uint8_t get_sim_rate(void);
void set_sim_rate(uint8_t rate);
void init_sim_settings(void);
#endif  //__SIM_SETTINGS_H
```

## include/simulate.h
```c
#ifndef __SIMULATE_H
#define __SIMULATE_H

#include <zephyr.h>

typedef enum {SIM_MSG_RESTART, SIM_MSG_NEXT, SIM_MSG_ADD_CONTACT} sim_msg_type_t;

typedef struct
{
	sim_msg_type_t type;
	void *p_data;
	union 
	{
            struct  {
		uint8_t rows;
		uint8_t space;
                uint8_t rate;
                };
            struct {
                uint16_t addr;
                int8_t rssi;
                }
	} params;
} sim_message_t;

void sim_msg_restart(uint8_t rows, uint8_t space, uint8_t rate);
void sim_msg_next(void);
#endif  //__SIMULATE_H
```

## src/contacts.c
```c
#include <zephyr.h>
#include <stdlib.h>
#include <math.h>
#include "errors.h"
#include "contacts.h"
#include "gus_data.h"
#include "gus_config.h"

////////////////////////
// declarations
////////////////////////
struct contact
{
    uint8_t badgeA;
    uint8_t badgeB;
    uint16_t start_time;
    uint16_t end_time;
    uint8_t distance;
};

////////////////////
// static variables
////////////////////
static uint16_t _final_time;
static uint16_t _total_contacts;
static uint32_t prox_start_time;
static struct contact _contact_list[MAX_CONTACTS];

/////////////////////
// Static functions
/////////////////////

// adds a new contact recored
static void add_contact(uint16_t badgeA, uint16_t badgeB, uint32_t start_time, uint32_t end_time, double distance)
{
    __ASSERT(_total_contacts < MAX_CONTACTS, "bad param");

    _contact_list[_total_contacts].badgeA = badgeA;
    _contact_list[_total_contacts].badgeB = badgeB;
    _contact_list[_total_contacts].start_time = start_time;
    _contact_list[_total_contacts].end_time = end_time;

    __ASSERT(distance != 0, "bad param");
    _contact_list[_total_contacts].distance = distance;
//    printk("added %4d %4d %4d %4d %4d\n", _total_contacts, badgeA, start_time, end_time, (int)distance); 
    _total_contacts++;

}

// calcuates the distance between two badges for classroom mode which assumes
// badges are in alphabetical order, in a number of row specified by "rows",
// and separated in distance by "space".
static uint8_t calc_distance(int badgeA, int badgeB, uint8_t rows, uint8_t space)
{
    double distance;
    uint8_t result;
    double x = (double)(badgeA % rows) - (double)(badgeB % rows);
    double y = (double)(badgeA / rows) - (double)(badgeB / rows);
    distance = space * 12.0 * sqrt(x * x + y * y);
    if (distance > 254)
        return 255;
    result = MAX(MIN(distance,255.0), 1.0);
    return result;
}


/////////////////////
// global functions
/////////////////////
uint16_t get_total_contacts(void)
{
    return _total_contacts;
}

uint16_t get_start_time(int index)
{
    return _contact_list[index].start_time;
}

uint16_t get_end_time(int index)
{
    return _contact_list[index].end_time;
}

uint16_t get_distance_squared(int index)
{
    uint16_t dist = _contact_list[index].distance;
    return dist * dist;
}

uint8_t get_contact_badgeA(int index)
{
    return _contact_list[index].badgeA;
}

uint8_t get_contact_badgeB(int index)
{
    return _contact_list[index].badgeB;
}

uint16_t final_time(void)
{
    return _final_time;
}


// create contacts for non-proximity simulation
void simulate_contacts(uint8_t rows, uint8_t space)
{
    _total_contacts = 0;
    uint16_t time = 0;
    uint8_t distance;
    uint8_t _badge_count = get_badge_count();

    for (uint16_t i = 1; i < 10; ++i)
    { 
        for (uint8_t badgeA = 0; badgeA < _badge_count; ++badgeA)
        {
            for (uint8_t badgeB = 0; badgeB < get_badge_count(); ++badgeB)
            {
                if (badgeA == badgeB)
                    continue;

                distance = calc_distance(badgeA, badgeB, rows, space);
                if (distance < SAFE_DISTANCE)
                {
                    add_contact(badgeA, badgeB, time, time + TIME_PER_CONTACT, distance);
                }
            }
        }
        time += TIME_PER_CONTACT;
    }
    _final_time = time;
}

void reset_proximity_contacts(void)
{
    prox_start_time = k_uptime_get_32();
    _total_contacts = 0;
}


void add_proximity_contact(uint16_t addr1, uint16_t addr2, int8_t rssi)
{
    // time in seconds since proximity checks were restarted
    uint32_t current_time = (k_uptime_get_32() - prox_start_time) / 1000;
    uint32_t interval = get_badge_count();

    uint16_t badgeA = get_badge_index_from_address(addr1);
    uint16_t badgeB = get_badge_index_from_address(addr2);
    if (rssi > -RSSI_TUNE_CONSTANT)
    {
        current_time *= DEMO_VIDEO_ACCEL;
        interval *= DEMO_VIDEO_ACCEL;
        double distance = 500.0 / (rssi + RSSI_TUNE_CONSTANT);
//        printk("contact %d-%d: %d %d\n", badgeA, badgeB, rssi, 500 / (rssi + RSSI_TUNE_CONSTANT));
//        if (distance<1.0) distance = 1.0;
        add_contact(badgeA, badgeB, current_time, current_time + interval, distance);
        _final_time = current_time + interval;
    }
}
```

## src/contacts.h
```c
#ifndef CONTACTS_H_
#define CONTACTS_H_

/////////////////////////////////////////////////////////////////////////////////
// This module manages the list of contacts between pairs of badges
// Contacts tracks when two badges are in close proximity.
// A new contact is added when two badges come near each other.
// A contact record contains the mesh node address of each of the badges,
// the start and end time of the contact and the distance of the contact.
// Contacts can be created in Classroom mode where distances are calculated, or
// in GUS_Tag mode where distances are approximated using the signal strength
// between badges.
// time is in seconds from when the contact calculation begins or when recording
// is started.
// badge addresses are limited to the range of 1-255
/////////////////////////////////////////////////////////////////////////////////

// Contact record Get access functions

// returns: total number of contact records
uint16_t get_total_contacts(void);

// index : index of the contact record
// returns : time the contact started
uint16_t get_start_time(int index);

// index : index of the contact record
// returns : time the contact ended
uint16_t get_end_time(int index);

// index : index of the contact record
// returns : square of the distance between the badges
uint16_t get_distance_squared(int index);

// index : index of the contact record
// returns : node address of first badge
uint8_t get_contact_badgeA(int index);

// index : index of the contact record
// returns : node address of second badge
uint8_t get_contact_badgeB(int index);

// returns : the time of the last contact
uint16_t final_time(void);

// Creates the list of contacts for classroom mode.  Assumes badges are in order
// of badge names and organized in one or more rows defined by the row parameter.
// rows : number of rows badges
// space : the distance between two adjacent badges.
void simulate_contacts( uint8_t rows, uint8_t space);

// resets the contact list and sets the start time
void reset_proximity_contacts(void);

// Adds a new contact between two badges.  The distance is calculated based on
// the rssi value
// addr1 : node address of the first badge
// addr2 : node address of the second badge
void add_proximity_contact(uint16_t addr1, uint16_t addr2, int8_t rssi);

#endif /* CONTACTS_H_ */
```

## src/errors.h
```c
#ifndef ERRORS_H_
#define ERRORS_H_

#define ERR_BAD_PARAM 
#endif // ERRORS_H_
```
